#include <dt-bindings/zmk/pointing.h>

/ {
    behaviors {
        mouse_scroll: mouse_scroll {
            compatible = "zmk,behavior-sensor-rotate-var";
            #sensor-binding-cells = <2>;
            bindings = <&msc SCRL_UP>, <&msc SCRL_DOWN>;
        };
    };
};